## CMakeLists.txt
```
cmake_minimum_required(VERSION 3.20.0)
find_package(Zephyr REQUIRED HINTS $ENV{ZEPHYR_BASE})

project(callback)

target_sources(app PRIVATE src/main.c src/function.c)
```

## prj.conf
```kconfig
CONFIG_SERIAL=y
CONFIG_CONSOLE=y
CONFIG_USE_SEGGER_RTT=y
CONFIG_RTT_CONSOLE=y

CONFIG_LOG=y
```

## src/main.c
```c
/*
 * Zephyr callback Example
 * Demonstrates the definition and use of custom callback functions.
 * 
 * Copyright (c) 2024 Aaron Mohtar & Co Pty Ltd
 * SPDX-License-Identifier: Apache-2.0
 */

#include <stdio.h>
#include <string.h>
#include <zephyr/device.h>
#include <zephyr/kernel.h>

#include <zephyr/logging/log.h>

#include "function.h"

LOG_MODULE_REGISTER(main);

void function_callback(struct CALLBACK_DATA *data)
{
        LOG_INF("Callback triggered with data1 %d", data->data1);
}


int main(void)
{
        printk("Zephyr callback example \nBoard: %s\n", CONFIG_BOARD);

        register_callback(function_callback);
        function_init();

        while(1)
        {
                k_msleep(1000);
        }
        return 0;
}
```

## src/function.c
```c
/*
 * function.c
 * Zephyr callback Example
 * Demonstrates the definition and use of custom callback functions.
 * 
 * Copyright (c) 2024 Aaron Mohtar & Co Pty Ltd
 * SPDX-License-Identifier: Apache-2.0
 */

#include "function.h"
#include <zephyr/logging/log.h>

LOG_MODULE_REGISTER(function);

callback_function callback = NULL;
struct CALLBACK_DATA callback_data = {.data1 = 0, .data2 = 0};

static struct k_work_delayable dwork;
static void work_function(struct k_work *work);

/**
 * @brief Reigster the callback function.
 */
int register_callback(callback_function *callback_function)
{
    LOG_INF("Register callback");
    callback = (void *)callback_function;
    return 0;
}

/**
 * @brief Initialises the work function that gets called every 100ms.
 */
int function_init()
{
    LOG_INF("Initialising function");
    k_work_init_delayable(&dwork,work_function);
    k_work_schedule(&dwork, K_NO_WAIT);
    return 0;
}


/** 
 * @brief Work function that gets called evey 100msec. Calls the callback every 10sec.
*/
static void work_function(struct k_work *work)
{
    static uint16_t delay_ms = 100;
    static uint16_t counter = 0;
    counter++;
  
    if(counter >= 100)
    {
        counter =0;
        // If registered, call the callback function and pass on data.
        if(callback != NULL)
        {
            LOG_INF("Callback called");
            callback_data.data1++;
            callback(&callback_data);
        }
        else
        {
            LOG_INF("No registered callback");
        }
    }

    //k_work_schedule(&work, K_MSEC(100));
    k_work_schedule(&dwork, K_MSEC(delay_ms));
}
```

## src/function.h
```c
/*
 * function.h
 * Zephyr callback Example
 * Demonstrates the definition and use of custom callback functions.
 * 
 * Copyright (c) 2024 Aaron Mohtar & Co Pty Ltd
 * SPDX-License-Identifier: Apache-2.0
 */

#include <zephyr/kernel.h>

// Define callback data structure.
struct CALLBACK_DATA {
        uint8_t data1;
        uint16_t data2;
};

typedef void (*callback_function)(struct CALLBACK_DATA *cb_data); // callback funtion type def

int register_callback(callback_function *callback_function);

int function_init();
```
