## CMakeLists.txt
```
cmake_minimum_required(VERSION 3.20.0)
find_package(Zephyr REQUIRED HINTS $ENV{ZEPHYR_BASE})

project(i2c_slave)

target_sources(app PRIVATE src/main.c)
```

## prj.conf
```kconfig
CONFIG_CONSOLE=y
CONFIG_USE_SEGGER_RTT=y
CONFIG_UART_CONSOLE=n
CONFIG_RTT_CONSOLE=y

CONFIG_LOG=y

CONFIG_I2C=y

CONFIG_NRFX_TWIS0=y
```

## lemon_iot_ble_nrf52832.overlay
```dts
// To get started, press Ctrl+Space to bring up the completion menu and view the available nodes.

// You can also use the buttons in the sidebar to perform actions on nodes.
// Actions currently available include:

// * Enabling / disabling the node
// * Adding the bus to a bus
// * Removing the node
// * Connecting ADC channels

// For more help, browse the DeviceTree documentation at https://docs.zephyrproject.org/latest/guides/dts/index.html
// You can also visit the nRF DeviceTree extension documentation at https://nrfconnect.github.io/vscode-nrf-connect/devicetree/nrfdevicetree.html

&pinctrl {
    i2c0_default: i2c0_default {
		group1 {
			psels = <NRF_PSEL(TWIM_SCL, 0, 27)>,
			<NRF_PSEL(TWIM_SDA, 0,26)>;
		};
	};
};

&i2c0 {
    compatible = "nordic,nrf-twim";
    status = "okay";
    //address-0 = <0x55>;
    pinctrl-0 = <&i2c0_default>;
    pinctrl-names = "default";
};
```

## lemon_iot_ble_nrf52840.overlay
```dts
// To get started, press Ctrl+Space to bring up the completion menu and view the available nodes.

// You can also use the buttons in the sidebar to perform actions on nodes.
// Actions currently available include:

// * Enabling / disabling the node
// * Adding the bus to a bus
// * Removing the node
// * Connecting ADC channels

// For more help, browse the DeviceTree documentation at https://docs.zephyrproject.org/latest/guides/dts/index.html
// You can also visit the nRF DeviceTree extension documentation at https://nrfconnect.github.io/vscode-nrf-connect/devicetree/nrfdevicetree.html

&pinctrl {
    i2c0_default: i2c0_default {
		group1 {
			psels = <NRF_PSEL(TWIM_SCL, 0, 27)>,
			<NRF_PSEL(TWIM_SDA, 0,26)>;
            bias-pull-up;
		};
	};
};

&i2c0 {
    compatible = "nordic,nrf-twis";
    status = "okay";
    //address-0 = <0x55>;
   // address-1 = <0x00>;
    pinctrl-0 = <&i2c0_default>;
    pinctrl-names = "default";
    
};
```

## src/main.c
```c
/*
 * Zephyr I2C slave/target example
 *
 * Copyright (c) 2023 Aaron Mohtar & Co Pty Ltd
 * SPDX-License-Identifier: Apache-2.0
 * 
 * Nordic TWIS reference: https://infocenter.nordicsemi.com/index.jsp?topic=%2Fdrivers_nrfx_v2.3.0%2Fgroup__nrfx__twis.html
 */

#include <stdio.h>
#include <string.h>

#include <zephyr/device.h>
#include <zephyr/kernel.h>

#include <zephyr/logging/log.h>

#include <nrfx_twis.h>


LOG_MODULE_REGISTER(i2c_slave);

#define I2C_SLAVE_ADDRESS       0x55
#define I2C_SDA_PIN     26
#define I2C_SCL_PIN     27

#define I2C_RX_BUFFER_SIZE      10

uint8_t i2c_rx_buffer[I2C_RX_BUFFER_SIZE];

const nrfx_twis_t i2c = NRFX_TWIS_INSTANCE(0);

// Register defines
#define REGISTER_WHO_AM_I       0xF0
#define REGISTER_CONFIG         0x01
#define REGISTER_STATUS         0x10

#define REGISTER_SIZE_WHO_AM_I  0x01
#define REGISTER_SIZE_CONFIG  0x01
#define REGISTER_SIZE_STATUS  0x01

uint8_t register_who_am_i[REGISTER_SIZE_WHO_AM_I];
uint8_t register_config[REGISTER_SIZE_CONFIG];
uint8_t register_status[REGISTER_SIZE_STATUS];
uint8_t register_unknown[] = {0xff};    // Register for when the incorrect register contents are requested

uint8_t last_written_register = 0x00;   // Stores the next register to read from

/*
* @brief i2c event handler
*/
void i2c_event_handler(nrfx_twis_evt_t const *p_event)
{

        switch (p_event->type)
        {
                case NRFX_TWIS_EVT_READ_REQ:
                {
                        switch(last_written_register)
                        {
                                case REGISTER_WHO_AM_I:
                                {
                                        nrfx_twis_tx_prepare(&i2c,register_who_am_i,REGISTER_SIZE_WHO_AM_I);
                                        break;
                                }
                                case REGISTER_CONFIG:
                                {
                                        nrfx_twis_tx_prepare(&i2c,register_config,REGISTER_SIZE_CONFIG);
                                        break;
                                }
                                case REGISTER_STATUS:
                                {
                                        nrfx_twis_tx_prepare(&i2c,register_status,REGISTER_SIZE_STATUS);
                                        break;
                                }
                                default:
                                {
                                        nrfx_twis_tx_prepare(&i2c,register_unknown,1);
                                        //LOG_INF("Read request for unknown register.\n");
                                }
                        }
                        break;
                }
                case NRFX_TWIS_EVT_READ_DONE:
                {
                        break;
                }
                case NRFX_TWIS_EVT_READ_ERROR:
                {
                        LOG_INF("Read error\n");
                        break;
                }
                case NRFX_TWIS_EVT_WRITE_REQ:
                {
                        nrfx_twis_rx_prepare(&i2c,i2c_rx_buffer,I2C_RX_BUFFER_SIZE);
                        //LOG_INF("Write request.\n");
                        break;
                }
                case NRFX_TWIS_EVT_WRITE_DONE:
                {
                        uint8_t len = p_event->data.rx_amount;
                        //LOG_INF("Write done. Len = %d\n", len);
                        if(len > 0)
                        {
                                last_written_register = i2c_rx_buffer[0];
                                if(len > 1)
                                {
                                        // Register write request - only 1 byte write implemented.
                                        switch (last_written_register)
                                        {
                                                case REGISTER_CONFIG:
                                                {
                                                        register_config[0] = i2c_rx_buffer[1];
                                                        LOG_INF("Register %02X changed to %02X.\n", i2c_rx_buffer[0],i2c_rx_buffer[1]);    
                                                        break;
                                                }
                                                default:
                                                {
                                                        LOG_INF("Unknown register %02X\n", i2c_rx_buffer[0]);
                                                }
                                        }   
                                }
                        }
                        break;
                }
                case NRFX_TWIS_EVT_WRITE_ERROR:
                {
                        LOG_INF("Write error\n");
                        break;
                }
                case NRFX_TWIS_EVT_GENERAL_ERROR:
                {
                        LOG_INF("General error\n");
                        break;
                }
                default:
                {
                }
        }
}



int main(void)
{
        printk("I2C slave/target example! \nBoard: %s\n", CONFIG_BOARD);

        // default register values
        register_who_am_i[0] = 0xAA;
        register_status[0] = 0x93;
        register_config[0] = 0x00;

        const nrfx_twis_config_t config = {
            .scl = I2C_SCL_PIN,
            .sda = I2C_SDA_PIN,
            .addr[0] = I2C_SLAVE_ADDRESS,
            .addr[1] = 0x00,
            .scl_pull = NRF_GPIO_PIN_PULLUP,    // update if pullups are externally set.
            .sda_pull = NRF_GPIO_PIN_PULLUP,
        };   
        // Initialise the I2C peripherial and interrupt
        nrfx_twis_init(&i2c, &config, i2c_event_handler);
        nrfx_twis_enable(&i2c);

        IRQ_CONNECT(SPIM0_SPIS0_TWIM0_TWIS0_SPI0_TWI0_IRQn, 3, nrfx_isr, nrfx_twis_0_irq_handler, 0);

        printk("Entering main loop.\n");

        while (1)
        {
                k_sleep(K_MSEC(1000));
        }
        return 0;
}
```

## src/led.c
```c
/*
 * led.c
 *
 * Copyright 2023 Aaron Mothar & Co Pty Ltd
 * Copyright (c) Aaron Mohtar & Craig Peacock
 * SPDX-License-Identifier: Apache-2.0
 *
 * This works with the LemonIot boards & requires three defined PWM pins:
 * - red_pwm_led
 * - green_pwm_led
 * - blue_pwm_led
 */

#include "led.h"

static struct rgb_led_data rgbData;
static enum led_mode mode = OFF;

static uint32_t pulse_width = 0U;

static struct k_work_delayable led_indicator_work;
static void led_indicator_work_function(struct k_work *work);

static const struct pwm_dt_spec pwm_led[] = {PWM_DT_SPEC_GET(DT_ALIAS(red_pwm_led)),
											 PWM_DT_SPEC_GET(DT_ALIAS(green_pwm_led)),
											 PWM_DT_SPEC_GET(DT_ALIAS(blue_pwm_led))};

static void led_indicator_work_function(struct k_work *work)
{
	// In test mode, don't do anything with LEDs.
	// if(mode == TEST)
	//{
	//	return;
	//}

	switch (rgbData.mode)
	{
	case ON:
	{
		rgbData.redLevel = rgbData.redLevelMax;
		rgbData.greenLevel = rgbData.greenLevelMax;
		rgbData.blueLevel = rgbData.blueLevelMax;
		break;
	}
	case OFF:
	{
		rgbData.redLevel = 0;
		rgbData.greenLevel = 0;
		rgbData.blueLevel = 0;
		break;
	}
	case HEARTBEAT:
	{

		if (rgbData.heartrateDirection == UP)
		{
			rgbData.redLevel += rgbData.redPulseStep;
			rgbData.greenLevel += rgbData.greenPulseStep;
			rgbData.blueLevel += rgbData.bluePulseStep;

			if ((rgbData.redLevel > rgbData.redLevelMax) || (rgbData.greenLevel > rgbData.greenLevelMax) || (rgbData.blueLevel > rgbData.blueLevelMax))
			{
				rgbData.redLevel = rgbData.redLevelMax;
				rgbData.greenLevel = rgbData.greenLevelMax;
				rgbData.blueLevel = rgbData.blueLevelMax;
				rgbData.heartrateDirection = DOWN;
			}
		}
		else // direction is DOWN
		{
			if ((rgbData.redLevel < rgbData.redPulseStep) || (rgbData.greenLevel < rgbData.greenPulseStep) || (rgbData.blueLevel < rgbData.bluePulseStep))
			{
				rgbData.redLevel = 0;
				rgbData.greenLevel = 0;
				rgbData.blueLevel = 0;
				rgbData.heartrateDirection = UP;
			}
			else
			{
				rgbData.redLevel -= rgbData.redPulseStep;
				rgbData.greenLevel -= rgbData.greenPulseStep;
				rgbData.blueLevel -= rgbData.bluePulseStep;
			}
		}
		break;
	}
	case PULSING:
	{

		break;
	}
	default:
	{
	}
	}

	led_configPwm(rgbData.redLevel, RED);
	led_configPwm(rgbData.greenLevel, GREEN);
	led_configPwm(rgbData.blueLevel, BLUE);

	if (rgbData.mode == HEARTBEAT)
	{
		k_work_schedule(&led_indicator_work, K_MSEC(25));
	}
	else
	{
		k_work_schedule(&led_indicator_work, K_MSEC(10));
	}

	return;

	// if (ret)
	//{
	//	printk("Error %d: failed to set pulse width\n", ret);
	//	return;
	// }
}
/*

 */
void led_initialise(uint8_t red, uint8_t green, uint8_t blue, enum led_mode newMode, uint16_t periodX10, uint8_t onPeriodX10)
{
	if (!device_is_ready(pwm_led[0].dev))
	{
		printk("Error: PWM device %s is not ready\n", pwm_led[0].dev->name);
		return;
	}

	led_changeColor(red, green, blue);
	rgbData.mode = newMode;
	rgbData.periodMsX10 = periodX10;
	rgbData.onPeriodMsX10 = onPeriodX10;

	k_work_init_delayable(&led_indicator_work, led_indicator_work_function);
	k_work_schedule(&led_indicator_work, K_MSEC(10));
}

void led_changeColor(uint8_t red, uint8_t green, uint8_t blue)
{
	rgbData.redLevelMax = red;
	rgbData.greenLevelMax = green;
	rgbData.blueLevelMax = blue;

	rgbData.redPulseStep = (float)rgbData.redLevelMax / 40;
	rgbData.greenPulseStep = (float)rgbData.greenLevelMax / 40;
	rgbData.bluePulseStep = (float)rgbData.blueLevelMax / 40;

	rgbData.redLevel = 0;
	rgbData.greenLevel = 0;
	rgbData.blueLevel = 0;
	rgbData.heartrateDirection = UP;
}

void led_changeMode(enum led_mode newMode)
{

}

int led_configPwm(uint8_t intensity, enum led_color color)
{
	pulse_width = ((float)intensity * pwm_led[color].period) / 256;
	return pwm_set_pulse_dt(&pwm_led[color], pulse_width);
}
```

## src/led.h
```c
/*
 * led.h
 *
 * Copyright 2023 Aaron Mothar & Co Pty Ltd
 * Copyright (c) Aaron Mohtar & Craig Peacock
 * SPDX-License-Identifier: Apache-2.0
 *
 */

#include <zephyr/kernel.h>
#include <zephyr/drivers/pwm.h>


enum device_mode{
	NORMAL,
	TEST,
};

enum led_mode{
	OFF,
	ON,
	HEARTBEAT,
	PULSING,
};

enum led_color
{
	RED = 0,
	GREEN,
	BLUE,
};

enum led_heartrateDirection
{
	UP,
	DOWN,
};

struct rgb_led_data{
	uint8_t redLevelMax;
	uint8_t greenLevelMax;
	uint8_t blueLevelMax;
	float redLevel;
	float greenLevel;
	float blueLevel;
	float redPulseStep;
	float greenPulseStep;
	float bluePulseStep;
	uint8_t heartrateDirection;
	enum led_mode	mode;
	uint16_t periodMsX10;
	uint8_t onPeriodMsX10;
};

static void led_indicator_work_function(struct k_work *work);

/** @brief Initialise the LED and set the default settings 
 * @param red sets the intensity of the red LED (0x00-0xFF)
 * @param green sets the intensity of the green LED (0x00-0xFF)
 * @param blue sets the intensity of the blue LED (0x00-0xFF)
 * @param newMode sets the LED mode: OFF = 0, ON = 1, HEARTRATE = 2, PUSLING = 3
 * @param periodX10 set the period of the LED in 10's or ms. This only applies when mode = PULSING. E.g. 100 -> 1000ms = 1s
 * @param onPeriodX10 set the ON period of the LED in 10's of ms. This only applies when mode = PULSING. 1 -> 10ms
*/
void led_initialise(uint8_t red,uint8_t green, uint8_t blue, enum led_mode newMode, uint16_t periodX10,uint8_t onPeriodX10);

/** @brief Changes ONLY the color of LED
 * @param red sets the intensity of the red LED (0x00-0xFF)
 * @param green sets the intensity of the green LED (0x00-0xFF)
 * @param blue sets the intensity of the blue LED (0x00-0xFF)
*/
void led_changeColor(uint8_t red,uint8_t green, uint8_t blue);

/** @brief Changes the LED mode 
 * @param newMode LED modes: OFF = 0, ON = 1, HEARTRATE = 2, PUSLING = 3
*/
void led_changeMode(enum led_mode newMode);

int led_configPwm(uint8_t intensity,enum led_color color);
```
